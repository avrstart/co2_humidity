/************************************************************************
	ili9163lcd.c

    ILI9163 128x128 LCD library
    Copyright (C) 2012 Simon Inns

    This program is free software: you can redistribute it and/or modify
    it under the terms of the GNU General Public License as published by
    the Free Software Foundation, either version 3 of the License, or
    (at your option) any later version.

    This program is distributed in the hope that it will be useful,
    but WITHOUT ANY WARRANTY; without even the implied warranty of
    MERCHANTABILITY or FITNESS FOR A PARTICULAR PURPOSE.  See the
    GNU General Public License for more details.

    You should have received a copy of the GNU General Public License
    along with this program.  If not, see <http://www.gnu.org/licenses/>.

	Email: simon.inns@gmail.com

************************************************************************/
#include "ili9163lcd.h"

// 5x8 Font data
// This font was created by Philippe Lucidarme and is available
// from http://piclist.com/techref/datafile/charset/8x6.htm
//
// Note: This table is arranged according to ASCII codes 0 to 255
const uint8_t font8x5[][6] = {
{0x00,0x00,0x00,0x00,0x00,0x00},   //   0x00 0
{0x00,0x64,0x18,0x04,0x64,0x18},   //   0x01 1
{0x00,0x3c,0x40,0x40,0x20,0x7c},   //   0x02 2
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{0x00,0x00,0x00,0x00,0x00,0x00}    // я 0xff 255
};

const uint8_t font8x12[][13] = {
    {0x00,0x00,0x00,0x00,0x00,0x00,0x00,0x00,0x00,0x00,0x00,0x00,0x00}, //0
    {0x00,0x00,0x00,0x00,0x00,0x00,0x00,0x00,0x00,0x00,0x00,0x00,0x00},
    {0x00,0x00,0x00,0x00,0x00,0x00,0x00,0x00,0x00,0x00,0x00,0x00,0x00},
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  {0x00,0x00,0x00,0x00,0x4C,0x32,0x00,0x00,0x00,0x00,0x00,0x00,0x00}
};

static void ili9163_reset(void);
static void ili9163_cmd(uint8_t address);
static void ili9163_param(uint8_t parameter);
static void ili9163_data(uint8_t dataByte1, uint8_t dataByte2);

// Low-level LCD driving functions --------------------------------------------------------------------------
static struct ili9163_operations *ili9163_ops;

inline uint16_t decodeRgbValue(uint8_t r, uint8_t g, uint8_t b)
{
	return (b << 11) | (g << 6) | (r);
}	

// Reset the LCD hardware
static void ili9163_reset(void)
{     
	// Reset pin is active low (0 = reset, 1 = ready)
	ili9163_ops->ili9163_write_reset(0);
    ili9163_ops->ili9163_delay_ms(50);
    ili9163_ops->ili9163_write_reset(1);
    ili9163_ops->ili9163_delay_ms(120);
}

static void ili9163_cmd(uint8_t address)
{   
	ili9163_ops->ili9163_write_cs(0);
	ili9163_ops->ili9163_write_datacom(0);
	ili9163_ops->ili9163_spi_send(&address);
	ili9163_ops->ili9163_write_cs(1);
}

static void ili9163_param(uint8_t parameter)
{  
	ili9163_ops->ili9163_write_cs(0);
	ili9163_ops->ili9163_write_datacom(1);
	ili9163_ops->ili9163_spi_send(&parameter);
	ili9163_ops->ili9163_write_cs(1);
}
 
static void ili9163_data(uint8_t dataByte1, uint8_t dataByte2)
{  
	ili9163_ops->ili9163_write_cs(0);
	ili9163_ops->ili9163_write_datacom(1);
	ili9163_ops->ili9163_spi_send(&dataByte1);
	ili9163_ops->ili9163_spi_send(&dataByte2);
	ili9163_ops->ili9163_write_cs(1);
}

uint8_t lcdTextX(uint8_t x) { return x*6; }
uint8_t lcdTextY(uint8_t y) { return y*8; }

// Initialise the display with the require screen orientation
void ili9163_init(struct ili9163_operations *init_ili9163, uint8_t orientation)
{   
	ili9163_ops = init_ili9163;

	// Hardware reset the LCD
	ili9163_reset();
	
    ili9163_cmd(EXIT_SLEEP_MODE);
    ili9163_ops->ili9163_delay_ms(5); // Wait for the screen to wake up
    
    ili9163_cmd(SET_PIXEL_FORMAT);
    ili9163_param(0x05); // 16 bits per pixel
   
    ili9163_cmd(SET_GAMMA_CURVE);
    ili9163_param(0x04); // Select gamma curve 3
	
    ili9163_cmd(GAM_R_SEL);
    ili9163_param(0x01); // Gamma adjustment enabled
    
    ili9163_cmd(POSITIVE_GAMMA_CORRECT);
    ili9163_param(0x3f); // 1st Parameter
    ili9163_param(0x25); // 2nd Parameter
    ili9163_param(0x1c); // 3rd Parameter
    ili9163_param(0x1e); // 4th Parameter
    ili9163_param(0x20); // 5th Parameter
    ili9163_param(0x12); // 6th Parameter
    ili9163_param(0x2a); // 7th Parameter
    ili9163_param(0x90); // 8th Parameter
    ili9163_param(0x24); // 9th Parameter
    ili9163_param(0x11); // 10th Parameter
    ili9163_param(0x00); // 11th Parameter
    ili9163_param(0x00); // 12th Parameter
    ili9163_param(0x00); // 13th Parameter
    ili9163_param(0x00); // 14th Parameter
    ili9163_param(0x00); // 15th Parameter
     
    ili9163_cmd(NEGATIVE_GAMMA_CORRECT);
    ili9163_param(0x20); // 1st Parameter
    ili9163_param(0x20); // 2nd Parameter
    ili9163_param(0x20); // 3rd Parameter
    ili9163_param(0x20); // 4th Parameter
    ili9163_param(0x05); // 5th Parameter
    ili9163_param(0x00); // 6th Parameter
    ili9163_param(0x15); // 7th Parameter
    ili9163_param(0xa7); // 8th Parameter
    ili9163_param(0x3d); // 9th Parameter
    ili9163_param(0x18); // 10th Parameter
    ili9163_param(0x25); // 11th Parameter
    ili9163_param(0x2a); // 12th Parameter
    ili9163_param(0x2b); // 13th Parameter
    ili9163_param(0x2b); // 14th Parameter
    ili9163_param(0x3a); // 15th Parameter
    
    ili9163_cmd(FRAME_RATE_CONTROL1);
    ili9163_param(0x08); // DIVA = 8
    ili9163_param(0x08); // VPA = 8
    
    ili9163_cmd(DISPLAY_INVERSION);
    ili9163_param(0x07); // NLA = 1, NLB = 1, NLC = 1 (all on Frame Inversion)
   
    ili9163_cmd(POWER_CONTROL1);
    ili9163_param(0x0a); // VRH = 10:  GVDD = 4.30
    ili9163_param(0x02); // VC = 2: VCI1 = 2.65
      
    ili9163_cmd(POWER_CONTROL2);
    ili9163_param(0x02); // BT = 2: AVDD = 2xVCI1, VCL = -1xVCI1, VGH = 5xVCI1, VGL = -2xVCI1

    ili9163_cmd(VCOM_CONTROL1);
    ili9163_param(0x50); // VMH = 80: VCOMH voltage = 4.5
    ili9163_param(0x5b); // VML = 91: VCOML voltage = -0.225
	
    ili9163_cmd(VCOM_OFFSET_CONTROL);
    ili9163_param(0x40); // nVM = 0, VMF = 64: VCOMH output = VMH, VCOML output = VML	
    
    ili9163_cmd(SET_COLUMN_ADDRESS);
    ili9163_param(0x00); // XSH
    ili9163_param(0x00); // XSL
    ili9163_param(0x00); // XEH
    ili9163_param(0x7f); // XEL (128 pixels x)

    ili9163_cmd(SET_PAGE_ADDRESS);
    ili9163_param(0x00);
    ili9163_param(0x00);
    ili9163_param(0x00);
    ili9163_param(0x9f); // 128 pixels y


	// Select display orientation
    ili9163_cmd(SET_ADDRESS_MODE);
	ili9163_param(orientation);

	// Set the display to on
    ili9163_cmd(SET_DISPLAY_ON);
    ili9163_cmd(WRITE_MEMORY_START);
}

// LCD graphics functions -----------------------------------------------------------------------------------

void ili9163_clear(uint16_t colour)
{
	uint16_t pixel;
  
	// Set the column address to 0-127
	ili9163_cmd(SET_COLUMN_ADDRESS);
	ili9163_param(0x00);
	ili9163_param(0x00);
	ili9163_param(0x00);
	ili9163_param(0x7f);

	// Set the page address to 0-127
	ili9163_cmd(SET_PAGE_ADDRESS);
	ili9163_param(0x00);
	ili9163_param(0x00);
	ili9163_param(0x00);
	ili9163_param(0x7f);
  
	// Plot the pixels
	ili9163_cmd(WRITE_MEMORY_START);
	for(pixel = 0; pixel < 16385; pixel++) ili9163_data(colour >> 8, colour);
}

void ili9163_plot(uint8_t x, uint8_t y, uint16_t colour)
{
	// Horizontal Address Start Position
	ili9163_cmd(SET_COLUMN_ADDRESS);
	ili9163_param(0x00);
	ili9163_param(x);
	ili9163_param(0x00);
	ili9163_param(0x7f);
  
	// Vertical Address end Position
	ili9163_cmd(SET_PAGE_ADDRESS);
	ili9163_param(0x00);
	ili9163_param(y);
	ili9163_param(0x00);
	ili9163_param(0x7f);

	// Plot the point
	ili9163_cmd(WRITE_MEMORY_START);
	ili9163_data(colour >> 8, colour);
}

// Draw a line from x0, y0 to x1, y1
// Note:	This is a version of Bresenham's line drawing algorithm
//			It only draws lines from left to right!
void ili9163_line(int16_t x0, int16_t y0, int16_t x1, int16_t y1, uint16_t colour)
{
	int16_t dy = y1 - y0;
	int16_t dx = x1 - x0;
	int16_t stepx, stepy;

	if (dy < 0)
	{
		dy = -dy; stepy = -1; 
	}
	else stepy = 1; 

 	if (dx < 0)
	{
		dx = -dx; stepx = -1; 
	}
	else stepx = 1; 

	dy <<= 1; 							// dy is now 2*dy
	dx <<= 1; 							// dx is now 2*dx
 
	ili9163_plot(x0, y0, colour);

	if (dx > dy) {
		int fraction = dy - (dx >> 1);	// same as 2*dy - dx
		while (x0 != x1)
		{
			if (fraction >= 0)
			{
				y0 += stepy;
				fraction -= dx; 		// same as fraction -= 2*dx
			}

   			x0 += stepx;
   			fraction += dy; 				// same as fraction -= 2*dy
   			ili9163_plot(x0, y0, colour);
		}
	}
	else
	{
		int fraction = dx - (dy >> 1);
		while (y0 != y1)
		{
			if (fraction >= 0)
			{
				x0 += stepx;
				fraction -= dy;
			}

			y0 += stepy;
			fraction += dx;
			ili9163_plot(x0, y0, colour);
		}
	}
}

// Draw a rectangle between x0, y0 and x1, y1
void ili9163_rectangle(int16_t x0, int16_t y0, int16_t x1, int16_t y1, uint16_t colour)
{
	ili9163_line(x0, y0, x0, y1, colour);
	ili9163_line(x0, y1, x1, y1, colour);
	ili9163_line(x1, y0, x1, y1, colour);
	ili9163_line(x0, y0, x1, y0, colour);
}

// Draw a filled rectangle
// Note:	y1 must be greater than y0  and x1 must be greater than x0
//			for this to work
void ili9163_FilledRectangle(int16_t x0, int16_t y0, int16_t x1, int16_t y1, uint16_t colour)
{
	uint16_t pixels;
			
	// To speed up plotting we define a x window with the width of the 
	// rectangle and then just output the required number of bytes to
	// fill down to the end point
	
	ili9163_cmd(SET_COLUMN_ADDRESS); // Horizontal Address Start Position
	ili9163_param(0x00);
	ili9163_param(x0);
	ili9163_param(0x00);
	ili9163_param(x1);
  
	ili9163_cmd(SET_PAGE_ADDRESS); // Vertical Address end Position
	ili9163_param(0x00);
	ili9163_param(y0);
	ili9163_param(0x00);
	ili9163_param(0x7f);
		
	ili9163_cmd(WRITE_MEMORY_START);
	
	for (pixels = 0; pixels < ((x1 - x0) * (y1 - y0)); pixels++)
		ili9163_data(colour >> 8, colour);;
}

// Draw a circle
// Note:	This is another version of Bresenham's line drawing algorithm.
//			There's plenty of documentation on the web if you are curious
//			how this works.
void ili9163_circle(int16_t xCentre, int16_t yCentre, int16_t radius, uint16_t colour)
{
	int16_t x = 0, y = radius;
	int16_t d = 3 - (2 * radius);
 
    while(x <= y)
	{
		ili9163_plot(xCentre + x, yCentre + y, colour);
		ili9163_plot(xCentre + y, yCentre + x, colour);
		ili9163_plot(xCentre - x, yCentre + y, colour);
		ili9163_plot(xCentre + y, yCentre - x, colour);
		ili9163_plot(xCentre - x, yCentre - y, colour);
		ili9163_plot(xCentre - y, yCentre - x, colour);
		ili9163_plot(xCentre + x, yCentre - y, colour);
		ili9163_plot(xCentre - y, yCentre + x, colour);

		if (d < 0) d += (4 * x) + 6;
		else
		{
			d += (4 * (x - y)) + 10;
			y -= 1;
		}

		x++;
	}
}

// LCD text manipulation functions --------------------------------------------------------------------------

// Plot a character at the specified x, y co-ordinates (top left hand corner of character)
void ili9163_putchar(unsigned char character, uint8_t x, uint8_t y, uint16_t fgColour, uint16_t bgColour)
{
	uint8_t row, column;
	
	// To speed up plotting we define a x window of 6 pixels and then
	// write out one row at a time.  This means the LCD will correctly
	// update the memory pointer saving us a good few bytes
	ili9163_cmd(SET_COLUMN_ADDRESS); // Horizontal Address Start Position
	ili9163_param(0x00);
	ili9163_param(x);
	ili9163_param(0x00);
    
#ifdef FONT8x5
	ili9163_param(x+5);
#else
	ili9163_param(x+7);
#endif
	ili9163_cmd(SET_PAGE_ADDRESS); // Vertical Address end Position
	ili9163_param(0x00);
	ili9163_param(y);
	ili9163_param(0x00);
	ili9163_param(0x7f);
		
	ili9163_cmd(WRITE_MEMORY_START);
	
	// Plot the font data
#ifdef FONT8x5
	for (row = 0; row < 8; row++)
	{
		for (column = 0; column < 6; column++)
		{
			if (font8x5[character][column] & (1 << row))
				ili9163_data(fgColour >> 8, fgColour);
			else ili9163_data(bgColour >> 8, bgColour);
		}
	}
#else
	for (row = 0; row < 13; row++)
	{
		uint8_t temp = font8x12[character][row];
		for (column = 0; column < 8; column++)
		{
			if (temp & 0x01)
				ili9163_data(fgColour >> 8, fgColour);
			else
				ili9163_data(bgColour >> 8, bgColour);
			temp >>= 1;
		}
	}
#endif
}

// Plot a string of characters to the LCD
void ili9163_puts(const char *string, uint8_t x, uint8_t y, uint16_t fgColour, uint16_t bgColour)
{
	uint8_t origin = x;

	for (uint8_t characterNumber = 0; characterNumber < strlen(string); characterNumber++)
	{
		// Check if we are out of bounds and move to 
		// the next line if we are
		if (x > 121)
		{
			x = origin;
			y += 8;
		}

		// If we move past the bottom of the screen just exit
		if (y > 120) break;

		// Plot the current character
		ili9163_putchar(string[characterNumber], x, y, fgColour, bgColour);
#ifdef FONT8x5
		x += 6;
#else        
        x += 9;
        #endif
	}
}


